## config/Kconfig.defconfig
```kconfig
# Custom Kconfig for cat display animation

if ZMK_DISPLAY

config ZMK_WIDGET_CAT_DISPLAY
    bool "Enable cat animation display widget"
    default y
    help
      Enable the custom cat animation widget for OLED displays.
      This adds a cute animated cat to your keyboard display.

config ZMK_CAT_ANIMATION_SPEED
    int "Cat animation frame duration in milliseconds"
    default 1000
    range 100 5000
    depends on ZMK_WIDGET_CAT_DISPLAY
    help
      Control how fast the cat animation cycles between frames.
      Lower values = faster animation, higher values = slower animation.

endif # ZMK_DISPLAY
```

## config/shields/corne/Kconfig.defconfig
```kconfig
config SHIELD_CORNE_LEFT
    def_bool $(shields_list_contains,corne_left)

config SHIELD_CORNE_RIGHT  
    def_bool $(shields_list_contains,corne_right)

if SHIELD_CORNE_LEFT || SHIELD_CORNE_RIGHT

config ZMK_KEYBOARD_NAME
    default "Corne"

if ZMK_DISPLAY

config I2C
    default y

config SSD1306
    default y

config ZMK_WIDGET_BONGO_CAT
    bool
    default y
    select LV_USE_IMG
    select LV_USE_ANIMATION

endif # ZMK_DISPLAY

if LVGL
config LV_Z_VDB_SIZE
    default 64
config LV_DPI_DEF
    default 148
config LV_Z_BITS_PER_PIXEL
    default 1
choice LV_COLOR_DEPTH
    default LV_COLOR_DEPTH_1
endchoice
endif # LVGL

endif # SHIELD_CORNE_LEFT || SHIELD_CORNE_RIGHT
```
